## main/Kconfig.projbuild
```kconfig
menu "Example Configuration"

    config ESP_WIFI_SSID
        string "SoftAP SSID"
        default "esp32_ssid"
        help
            SSID (network name) to set up the softAP with.

    config ESP_WIFI_PASSWORD
        string "SoftAP Password"
        default "esp32_pwd"
        help
            WiFi password (WPA or WPA2) for the example to use for the softAP.

    config ESP_MAX_STA_CONN
        int "Maximal STA connections"
        default 4
        help
            Max number of the STA connects to AP.


    config PIN_NUM_MISO
        int "SPI MISO GPIO"
        range 0 34
        default 19
        help
            GPIO number (IOxx) for SPI MISO Connection.
    
            Some GPIOs are used for other purposes (flash connections, etc.) and cannot be used.
    
            GPIOs 35-39 are input-only so cannot be used as outputs.
    
    config PIN_NUM_MOSI
        int "SPI MOSI GPIO"
        range 0 34
        default 23
        help
            GPIO number (IOxx) for SPI MOSI Connection.
    
            Some GPIOs are used for other purposes (flash connections, etc.) and cannot be used.
    
            GPIOs 35-39 are input-only so cannot be used as outputs.
    
    config PIN_NUM_CLK
        int "SPI CLK GPIO"
        range 0 34
        default 18
        help
            GPIO number (IOxx) for SPI Clock Connection.
    
            Some GPIOs are used for other purposes (flash connections, etc.) and cannot be used.
    
            GPIOs 35-39 are input-only so cannot be used as outputs.
    
    config PIN_NUM_CS
        int "SPI CS GPIO"
        range 0 34
        default 5
        help
            GPIO number (IOxx) for SPI Cable Select Connection.
    
            Some GPIOs are used for other purposes (flash connections, etc.) and cannot be used.
    
            GPIOs 35-39 are input-only so cannot be used as outputs.
            
endmenu
```
